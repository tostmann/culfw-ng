## sdkconfig.defaults
```kconfig
# Partition Table
CONFIG_PARTITION_TABLE_CUSTOM=y
CONFIG_PARTITION_TABLE_CUSTOM_FILENAME="partitions.csv"
CONFIG_PARTITION_TABLE_FILENAME="partitions.csv"

# Compiler Options
CONFIG_COMPILER_OPTIMIZATION_SIZE=y
CONFIG_FREERTOS_HZ=1000

# Matter / BLE / Thread Requirements
CONFIG_BT_ENABLED=y
CONFIG_BT_NIMBLE_ENABLED=y
CONFIG_BT_NIMBLE_ROLE_PERIPHERAL=y
CONFIG_BT_NIMBLE_ROLE_CENTRAL=n
CONFIG_BT_NIMBLE_MAX_CONNECTIONS=3

# LWIP (IPv6 Support)
CONFIG_LWIP_IPV6=y
CONFIG_LWIP_IPV6_AUTOCONFIG=y
CONFIG_LWIP_IPV6_DHCP6=y

# mDNS
CONFIG_LWIP_DNS_SUPPORT_MDNS_QUERIES=y

# Stack Sizes
CONFIG_ESP_SYSTEM_EVENT_TASK_STACK_SIZE=4096
CONFIG_MAIN_TASK_STACK_SIZE=8192

# Thread
CONFIG_OPENTHREAD_ENABLED=y
CONFIG_OPENTHREAD_RADIO_NATIVE=y
CONFIG_OPENTHREAD_NETWORK_CORE_STACK=y
CONFIG_ESP_OPENTHREAD_ENABLED=y
CONFIG_ESP_MATTER_ENABLE_OPENTHREAD=y

# Matter Specifics (Enabling via SDK)
CONFIG_ESP_MATTER_ENABLE=y
CONFIG_CHIP_PROJECT_CONFIG="main/include/CHIPProjectConfig.h"

# Device Identification (Default)
CONFIG_DEVICE_TYPE_ESP32_C6=y
CONFIG_ESP_INSIGHTS_ENABLED=n
CONFIG_ESPTOOLPY_FLASHSIZE_4MB=y
CONFIG_ESPTOOLPY_FLASHSIZE="4MB"
CONFIG_PARTITION_TABLE_CUSTOM=y
CONFIG_PARTITION_TABLE_CUSTOM_FILENAME="partitions.csv"
CONFIG_MBEDTLS_HKDF_C=y
CONFIG_PARTITION_TABLE_OFFSET=0x8000
```

## sdkconfig.defaults.serial
```kconfig
# Disable everything networking
CONFIG_ESP_WIFI_ENABLED=n
CONFIG_ESP32_WIFI_ENABLED=n
CONFIG_OPENTHREAD_ENABLED=n
CONFIG_BT_ENABLED=n
CONFIG_BT_NIMBLE_ENABLED=n

# Disable Matter
CONFIG_ESP_MATTER_ENABLE=n
CONFIG_ESP_MATTER_ENABLE_WIFI=n
CONFIG_ESP_MATTER_ENABLE_OPENTHREAD=n
CONFIG_ESP_MATTER_ENABLE_DATA_MODEL=n

# Custom Partition Table
CONFIG_PARTITION_TABLE_CUSTOM=y
CONFIG_PARTITION_TABLE_CUSTOM_FILENAME="partitions.csv"
CONFIG_PARTITION_TABLE_FILENAME="partitions.csv"
CONFIG_PARTITION_TABLE_OFFSET=0x8000
CONFIG_ESPTOOLPY_FLASHSIZE_4MB=y
CONFIG_ESPTOOLPY_FLASHSIZE="4MB"

# Enable USB-Serial-JTAG for console and low-level communication
CONFIG_SOC_USB_SERIAL_JTAG_SUPPORTED=y
CONFIG_USJ_ENABLE_USB_SERIAL_JTAG=y
CONFIG_ESP_CONSOLE_USB_SERIAL_JTAG=y
CONFIG_ESP_CONSOLE_SECONDARY_USB_SERIAL_JTAG=y
CONFIG_ESP_CONSOLE_USB_SERIAL_JTAG_ENABLED=y
```

## sdkconfig.defaults.thread
```kconfig
CONFIG_ESP_MATTER_ENABLE_DATA_MODEL=y
CONFIG_ESP_MATTER_ENABLE_WIFI=n
CONFIG_ESP_MATTER_ENABLE_OPENTHREAD=y
CONFIG_OPENTHREAD_ENABLED=y
CONFIG_ESP_WIFI_ENABLED=n
CONFIG_ESP32_WIFI_ENABLED=n
CONFIG_WIFI_ENABLED=n
CONFIG_ESP_WIFI_SOFTAP_SUPPORT=n
CONFIG_ESP_MATTER_COMMISSIONER_ENABLE_WIFI=n
```

## sdkconfig.defaults.wifi
```kconfig
CONFIG_ESP_MATTER_ENABLE_WIFI=y
CONFIG_ESP_MATTER_ENABLE_OPENTHREAD=n
CONFIG_OPENTHREAD_ENABLED=n
CONFIG_ESP_WIFI_ENABLED=y
CONFIG_ESP32_WIFI_ENABLED=y
CONFIG_SUPPORT_CLOSURE_CONTROL_CLUSTER=n
CONFIG_SUPPORT_CLOSURE_DIMENSION_CLUSTER=n
```
